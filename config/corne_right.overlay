/*
 * RIGHT half = split PERIPHERAL. Physically holds the PIM447 trackball on the
 * shared OLED I2C bus. The custom polled driver (src/pim447_poll.c) reads the
 * ball here and reports input events; zmk,input-split forwards them to the
 * central. The driver polls, so int-gpios is an unused (binding-required) dummy.
 */
#include "corne.dtsi"

&pro_micro_i2c {
    status = "okay";

    trackball: trackball@a {
        compatible = "zmk,pimoroni-pim447";
        reg = <0x0a>;
        int-gpios = <&gpio0 8 0>;
        status = "okay";
    };
};

&trackball_split {
    device = <&trackball>;
};
