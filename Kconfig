## Kconfig
```kconfig
config ZMK_I2C_SCANNER
	bool "Boot-time I2C bus scanner (diagnostic)"
	depends on I2C
	help
	  Probes I2C addresses 0x08-0x77 on i2c0 and logs which ACK. Diagnostic only.

config ZMK_GPIO_FINDER
	bool "Boot-time GPIO INT-finder (diagnostic)"
	help
	  Watches free nice!nano GPIO pads and logs which goes LOW. Diagnostic only.

config ZMK_PIM447_POLL
	bool "Pimoroni PIM447 trackball (polled input driver)"
	depends on I2C && INPUT
	help
	  Polling I2C driver for the PIM447 trackball. Binds to the t0bybr module's
	  "zmk,pimoroni-pim447" devicetree binding but reads on a timer instead of
	  using the interrupt line. Reports movement + click via the input subsystem.
	  INPUT is already provided by ZMK_POINTING; depend on it (do NOT select, or
	  it forms a Kconfig dependency loop through I2C).
```

## config/west.yml
```yaml
manifest:
  remotes:
    - name: zmkfirmware
      url-base: https://github.com/zmkfirmware
    # nice_oled
    - name: mctechnology17
      url-base: https://github.com/mctechnology17
    # pim447 trackball driver
    - name: t0bybr
      url-base: https://github.com/t0bybr
  projects:
    - name: zmk
      remote: zmkfirmware
      revision: v0.3.0
      import: app/west.yml
    # nice_oled
    - name: zmk-nice-oled
      remote: mctechnology17
      revision: main
    # pim447 trackball driver (PIM447 native pointing)
    - name: pim447
      remote: t0bybr
      revision: main
  self:
    path: config
```

## dts/bindings/input/zmk,pim447-poll.yaml
```yaml
description: Pimoroni PIM447 trackball, polled over I2C (no interrupt line needed)

compatible: "zmk,pim447-poll"

include: i2c-device.yaml

properties:
  poll-interval-ms:
    type: int
    default: 15
    description: How often to read the trackball, in milliseconds.

  scale:
    type: int
    default: 1
    description: Integer multiplier applied to raw movement deltas.
```
